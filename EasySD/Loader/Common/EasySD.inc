; This file is included by other files.
; It contains EasySD cartridge-specific constants.

; EasySD Commands
COMMAND_READ_FILE         = 78
COMMAND_OPEN_FILE         = 2
COMMAND_CLOSE_FILE        = 3
COMMAND_WRITE_FILE        = 4
COMMAND_DELETE_FILE       = 5
COMMAND_SEEK_FILE         = 6
COMMAND_LONG_SEEK_FILE    = 7
COMMAND_GET_INFO_FOR_FILE = 8
COMMAND_GET_PATH          = 9
COMMAND_READ_DIR 	  = 10
COMMAND_CHANGE_DIR 	  = 11
COMMAND_DELETE_DIR 	  = 12
COMMAND_CREATE_DIR 	  = 13
COMMAND_SET_PORT  	  = 20
COMMAND_SET_IO  	  = 21
COMMAND_SET_SOURCE  	  = 22
COMMAND_INVOKE_WITH_NAME  = 23
COMMAND_INVOKE_WITH_INDEX = 24   ; Menu-only PRG launch by page + row index
COMMAND_STREAM		  = 25
COMMAND_NI_STREAM 	  = 26
COMMAND_END_TALKING  	  = 30
COMMAND_EXIT_TO_MENU  	  = 31
COMMAND_CHANGE_DIR_INDEX  = 33   ; Menu-only directory change by page + row index

; Other EasySD constants
SOURCE_TYPE_SD  	  = 1
SOURCE_TYPE_HTTP  	  = 2
SOURCE_TYPE_FTP  	  = 3
SEEK_DIRECTION_START	  = 0
SEEK_DIRECTION_CURRENT    = 1
SEEK_DIRECTION_END	  = 2
; Cartridge status
CARTRIDGE_READY 	  = $00
CARTRIDGE_PROCESSING	  = $01
CARTRIDGE_FILE_IO_ERROR	  = $02
CARTRIDGE_PROCESS_OK	  = $80

; KERNAL replacement stuff
KERNAL_FILENAME_LENGTH	  = $B7
KERNAL_FILENAME_HIGH	  = $BC
KERNAL_FILENAME_LOW	  = $BB
KERNAL_LOGICAL_NUMBER	  = $B8
KERNAL_DEVICE_NUMBER	  = $BA
KERNAL_SECONDARY_ADDRESS  = $B9
KERNAL_STATUS 		  = $90

; Aliases for convenience
FILE_LENGTH               = KERNAL_FILENAME_LENGTH
FILENAME_LOW              = KERNAL_FILENAME_LOW
FILENAME_HIGH   	  = KERNAL_FILENAME_HIGH

; Other
MODULATION_ADDRESS	  = $DF00
