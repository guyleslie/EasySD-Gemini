; This file is included by other files.
; It contains system-wide constants.

; KERNAL functions
CHROUT    	= $FFD2
GETIN 	  	= $FFE4
SCNKEY 		= $FF9F
RESETROUTINE = $FCE2

; KERNAL Entry Points (Direct)
K_OPEN   = $F34A
K_CLOSE  = $F291
K_CHKIN  = $F20E
K_CHRIN  = $F157
K_CLRCHN = $F32F

; KERNAL/System vectors
IRQVECTOR	= $0314
ROM_IRQ_HANDLER = $0314 ; Alias for compatibility
SOFTNMIVECTOR	= $0318
NMI_LO		= $0318
NMI_HI		= $0319
IRQ6502		= $FFFE
NMI6502		= $FFFA
DEFAULT_NMI_HANDLER = $FE47 ; a.k.a. ROMNMIHANDLER
ROMNMIHANDLER	= $FE47
ROMIRQHANDLER	= $FF48

; KERNAL RAM Vectors
V_OPEN   = $031A
V_CLOSE  = $031C
V_CHKIN  = $031E
V_CLRCHN = $0322
V_CHRIN  = $0324

; VIC-II registers
BORDER		= $D020
SCREEN		= $D021
VIC_CONTROL_1	= $D011
VIC_RASTER_LINE = $D012
VIC_INT_CONTROL	= $D01A
VIC_INT_ACK	= $D019
VIC_BORDER_COLOR= $D020

; VIC-II Bit masks
VIC_DEN         = $10 ; Display Enable
VIC_INT_RASTER  = $01 ; Raster interrupt bit

; CIA registers
CIA_1_BASE 	= $DC00
CIA_2_BASE 	= $DD00
DATA_A		= 0
DATA_B		= 1
DDR_A		= 2
DDR_B		= 3
TIMER_A_LO	= $04
TIMER_A_HI	= $05
CIA_INT_MASK	= $0D
CIA_TIMER_A_CTRL= $0E
CIA_TIMER_B_CTRL= $0F
CRA_TOD_IN_50HZ			= 128
CRA_SP_MODE_OUTPUT		= 64
CRA_IN_MODE_CNT 		= 32
CRA_FORCE_LOAD 			= 16
CRA_RUN_MODE_ONE_SHOT 	= 8
CRA_OUT_MODE_TOGGLE 	= 4
CRA_PB6_ON 				= 2
CRA_START 				= 1

; I/O ports
PROCESSOR_PORT	= $01
PP_CONFIG_ALL_RAM = $34
PP_CONFIG_RAM_ON_ROM = $35
PP_CONFIG_RAM_ON_BASIC = $36
PP_CONFIG_DEFAULT = $37

; Other common memory locations
CASSETTEBUFFER = $033C
SIDLOAD		= $E000